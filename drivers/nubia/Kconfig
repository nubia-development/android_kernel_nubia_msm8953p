## drivers/nubia/Kconfig
```kconfig
#
# Nubia drivers configuration
#

#menuconfig NUBIA_DRIVERS
menu "nubia drivers"

config NUBIA_DRIVERS
	bool "NUBIA DRIVERS"
	default n
	help
	  Say Y here if you want to enable NUBIA DRIVERS
	  If unsure, say N.

comment "Nubia Device Drivers"

if NUBIA_DRIVERS
# Add nubia drivers configuration here

config NUBIA_NFC
	bool "NUBIA_NFC"
	default n
	help
	 Say Y here if you have enable NUBIA_NFC
	 IF  unsure ,say N
config NUBIA_HW_VERSION
        bool "NUBIA HW VERSION"
        default n
        help
          Say Y here if you have enable NUBIA_HW_VERSION
          IF  unsure ,say N
source "drivers/nubia/hw_version/Kconfig"
if NUBIA_NFC
source "drivers/nubia/nfc/Kconfig"
endif

config NUBIA_SENSORS
	bool "NUBIA_SENSORS"
	depends on NUBIA_DRIVERS
	default n
	help
	  Say Y here if you don't want to enable NUBIA_SENSORS
	  
if NUBIA_SENSORS
source drivers/nubia/sensors/Kconfig
endif

config NUBIA_TOUCHSCREENS
	bool "NUBIA_TOUCHSCREENS"
	depends on NUBIA_DRIVERS
	default n
	help
	  Say Y here if you want to enable NUBIA_TOUCHSCREENS
	  If unsure, say N.

if NUBIA_TOUCHSCREENS
source "drivers/nubia/touch/Kconfig"
endif

config NUBIA_FINGERPRINT
	bool "NUBIA_FINGERPRINT"
	depends on NUBIA_DRIVERS
	default n
	help
	  Say Y here if you want to enable NUBIA_FINGERPRINT
	  If unsure, say N.
if NUBIA_FINGERPRINT
source "drivers/nubia/fingerprint/Kconfig"
endif

endif

endmenu

# Nubia configuration options

config MACH_NUBIA
    bool "NUBIA device"
    depends on ARCH_MSM
    help
      Support for Nubia products

config MACH_NUBIA_MSM8953
    bool "NUBIA MSM8953"
    depends on ARCH_MSM8953
    select MACH_NUBIA
    help
      Support for MSM8953 Nubia variants

menu "Nubia board selection"

config MACH_NUBIA_NX612J
    bool "NUBIA_NX612J board"
    select MACH_NUBIA_MSM8953
    help
      Support for Nubia V18 variant

config MACH_NUBIA_NX608J
    bool "NUBIA_NX608J board"
    select MACH_NUBIA_MSM8953
    help
      Support for Nubia N3(OPEN) variant

config MACH_NUBIA_NX617J
    bool "NUBIA_NX617J board"
    select MACH_NUBIA_MSM8953
    help
      Support for Nubia N3(CMCC) variant

config MACH_NUBIA_NX618J
    bool "NUBIA_NX618J board"
    select MACH_NUBIA_MSM8953
    help
      Support for Nubia N3(CUCC) variant

endmenu
```
